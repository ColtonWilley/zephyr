## tests/net/socket/tls_ext/testcase.yaml
```yaml
common:
  tags:
    - net
    - socket
    - tls
tests:
  net.socket.tls.ext:
    platform_allow: qemu_x86
    integration_platforms:
      - qemu_x86

  net.socket.tls.ext.wolfssl:
    platform_allow: native_sim
    tags: net socket tls wolfssl
    extra_args:
      - OVERLAY_CONFIG=overlay-wolfssl.conf

  net.socket.tls.ext.wolfssl.verify_cb:
    platform_allow: native_sim
    tags: net socket tls wolfssl
    extra_args:
      - OVERLAY_CONFIG=overlay-wolfssl-verify-cb.conf
```
